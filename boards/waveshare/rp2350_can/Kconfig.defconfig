## boards/waveshare/rp2350_can/Kconfig.defconfig
```kconfig
# Copyright (c) 2025 Stephano Cetola
# Copyright (c) 2026 Benjamin Schilling
# SPDX-License-Identifier: Apache-2.0

if BOARD_RP2350_CAN

config USB_SELF_POWERED
	default n

endif # BOARD_RP2350_CAN
```

## boards/waveshare/rp2350_can/board.yml
```yaml
board:
  name: rp2350_can
  full_name: RP2350-CAN
  vendor: waveshare
  socs:
  - name: rp2350a
```
