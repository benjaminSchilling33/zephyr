/*
 * Copyright (c) 2025 Stephano Cetola
 * Copyright (c) 2026 Benjamin Schilling
 *
 * SPDX-License-Identifier: Apache-2.0
 */

/dts-v1/;

#include <raspberrypi/rpi_pico/rp2350a.dtsi>
#include <raspberrypi/rpi_pico/m33.dtsi>

#include "rp2350_can.dtsi"
